#include "sys.h"
#include "delay.h"
#include "usart.h"
#include "FreeRTOS.h"
#include "task.h"
#include "usart_referee.h"
#include "bsp_can1.h"
#include "bsp_time_8.h"
#include "decision.h"
#include<stdlib.h>

u16 time[1000] = {341,567,334,900,569,624,578,958,662,964,405,445,481,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649,};
	
int ccc = 0;
int delay = 0;
int last_armor_id = 0,last_shoot_heats = 0,shoot_heats = 0;
int armor_id = 0;
int robot_id = 0;
int rand_time = 0;

extern decision_all_data_t decision_all_data;


int main(void)
{ 
	NVIC_PriorityGroupConfig(NVIC_PriorityGroup_4);//设置系统中断优先级分组4
	delay_init(168);		//初始化延时函数
	usart6_init();
	ENC_Init();
	CAN_Configure();
	delay_ms(500);
	
	while(1)
	{			
		  last_armor_id = armor_id;
		  last_shoot_heats = shoot_heats;
			if(decision_all_data._robot_hurt.robot_hurt.armor_type != 10 && decision_all_data._robot_hurt.robot_hurt.hurt_type != 10 && decision_all_data._robot_hurt.robot_hurt.hurt_type == 0)
			{	
				armor_id = decision_all_data._robot_hurt.robot_hurt.armor_type + 1;
				decision_all_data._robot_hurt.robot_hurt.armor_type = 10;
				decision_all_data._robot_hurt.robot_hurt.hurt_type = 10;
				delay = 0;
				rand_time = (rand_time+1)%1000;
			}else{
				armor_id = 0;
			}
			if(armor_id == 0)
			{
				delay ++;
				if(delay<(time[rand_time]+450))
				{
					armor_id = last_armor_id;
				}
			}
			
			if(decision_all_data._power_heat_data.power_heat_data.shooter_id1_17mm_cooling_heat <= 800 )
				shoot_heats = decision_all_data._power_heat_data.power_heat_data.shooter_id1_17mm_cooling_heat;
		
    robot_id = 	decision_all_data._game_robot_state.game_robot_state.robot_id;
		can1_send_encoder( TIM8->CNT, armor_id, shoot_heats,robot_id );
	  ccc ++;
		delay_ms(1);
	}
	
}






